## firmware/main/Kconfig.projbuild
```kconfig
menu "Hilo Buddy"

config BUDDY_TZ_OFFSET_MIN
    int "Local time offset from UTC, in minutes"
    range -720 840
    default -360
    help
        Default for the time zone setting until a Mac or the panel changes it (then kept in NVS). UTC-6 is Mexico.

config BUDDY_DEMO
    bool "Play a scripted demo Mac instead of starting BLE"
    default n

config BUDDY_SLEEP_BRIGHTNESS
    int "Panel brightness on the sleep clock (percent)"
    range 0 100
    default 20
    help
        The sleep clock is already drawn in dim colors; this lowers the panel itself too.

endmenu
```
